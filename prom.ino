byte cmd[100];
byte cmdLen = 0;

const byte P_A1 = 46;
const byte P_A2 = 47;
const byte P_A3 = 48;
const byte P_A4 = 49;
const byte P_A5 = 50;
const byte P_A6 = 51;
const byte P_A7 = 52;
const byte P_A8 = 53;

const byte P_D1 = 30;
const byte P_D2 = 31;
const byte P_D3 = 32;
const byte P_D4 = 33;

const byte P_CS = 39;
const byte P_W1 = 40;
const byte P_W2 = 41;
const byte P_W3 = 42;
const byte P_W4 = 43;

unsigned char PromData[4][256] = {
{
    0x08, 0x08, 0x00, 0x0F, 0x0C, 0x02, 0x00, 0x09, 0x07, 0x0D, 0x01, 0x00, 0x0D, 0x03, 0x00, 0x09, 
    0x0F, 0x00, 0x03, 0x09, 0x0B, 0x00, 0x03, 0x08, 0x00, 0x0F, 0x09, 0x0C, 0x00, 0x0F, 0x0F, 0x09, 
    0x0D, 0x00, 0x0F, 0x0F, 0x00, 0x01, 0x08, 0x00, 0x06, 0x0D, 0x01, 0x00, 0x00, 0x0B, 0x0D, 0x00, 
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    0x02, 0x00, 0x00, 0x0B, 0x0D, 0x02, 0x00, 0x00, 0x00, 0x00, 0x00, 0x0F, 0x00, 0x0F, 0x00, 0x00, 
},

{
    0x0D, 0x05, 0x0A, 0x07, 0x08, 0x01, 0x0D, 0x0A, 0x0A, 0x08, 0x01, 0x0D, 0x08, 0x01, 0x0D, 0x0C, 
    0x0D, 0x0F, 0x01, 0x0C, 0x09, 0x0F, 0x00, 0x0C, 0x01, 0x00, 0x0A, 0x0D, 0x02, 0x0E, 0x0F, 0x0A, 
    0x08, 0x02, 0x0E, 0x0F, 0x0A, 0x00, 0x08, 0x03, 0x0F, 0x0A, 0x01, 0x0D, 0x01, 0x0F, 0x0A, 0x01, 
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    0x01, 0x0D, 0x03, 0x0F, 0x08, 0x01, 0x0D, 0x06, 0x00, 0x00, 0x00, 0x00, 0x00, 0x0F, 0x00, 0x00, 
} ,
//cassette rom
{
    0x0A, 0x0A, 0x02, 0x0E, 0x0F, 0x0A, 0x08, 0x02, 0x0E, 0x0F, 0x0A, 0x0F, 0x0C, 0x0A, 0x01, 0x0D, 
    0x01, 0x0F, 0x0A, 0x01, 0x0D, 0x09, 0x00, 0x00, 0x02, 0x0E, 0x0F, 0x0C, 0x09, 0x0F, 0x0E, 0x0C, 
    0x08, 0x0D, 0x0E, 0x0A, 0x0F, 0x0A, 0x00, 0x08, 0x02, 0x08, 0x02, 0x08, 0x02, 0x08, 0x02, 0x0E, 
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    0x06, 0x0A, 0x02, 0x0C, 0x02, 0x0A, 0x02, 0x0E, 0x02, 0x0E, 0x02, 0x0D, 0x00, 0x0E, 0x02, 0x06, 
},
{
    0x09, 0x0A, 0x00, 0x0F, 0x0F, 0x09, 0x0D, 0x00, 0x0F, 0x0F, 0x00, 0x0F, 0x08, 0x0D, 0x01, 0x00, 
    0x00, 0x0B, 0x0D, 0x00, 0x00, 0x09, 0x00, 0x02, 0x00, 0x0F, 0x0F, 0x09, 0x0B, 0x00, 0x01, 0x09, 
    0x0D, 0x00, 0x09, 0x02, 0x0F, 0x09, 0x00, 0x05, 0x04, 0x05, 0x05, 0x05, 0x06, 0x05, 0x07, 0x08, 
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    0x00, 0x05, 0x06, 0x05, 0x04, 0x05, 0x07, 0x05, 0x05, 0x06, 0x06, 0x00, 0x02, 0x06, 0x07, 0x00, 
} 

};


void setup() {
    pinMode(P_A1, OUTPUT);
    pinMode(P_A2, OUTPUT);
    pinMode(P_A3, OUTPUT);
    pinMode(P_A4, OUTPUT);
    pinMode(P_A5, OUTPUT);
    pinMode(P_A6, OUTPUT);
    pinMode(P_A7, OUTPUT);
    pinMode(P_A8, OUTPUT);

    pinMode(P_D1, INPUT);
    pinMode(P_D2, INPUT);
    pinMode(P_D3, INPUT);
    pinMode(P_D4, INPUT);

    pinMode(P_CS, OUTPUT);
    digitalWrite(P_CS,HIGH);  //disable chip
    pinMode(P_W1, OUTPUT);
    pinMode(P_W2, OUTPUT);
    pinMode(P_W3, OUTPUT);
    pinMode(P_W4, OUTPUT);
    writeData(0); //clear it
    
    Serial.begin(9600);
    Serial.println("List des commandes:");
    Serial.println("  r - lire le contenue");
    Serial.println("  w? - programmer le rom #? sur le chip");
    Serial.println("  c? - comparer le rom #? avec le chip");
    Serial.println("");
    Serial.print("> ");
    cmdLen = 0;
}

void setAdresse(byte addr){
  if (addr & 1) digitalWrite(P_A1,HIGH); else digitalWrite(P_A1,LOW);
  if (addr & 2) digitalWrite(P_A2,HIGH); else digitalWrite(P_A2,LOW);
  if (addr & 4) digitalWrite(P_A3,HIGH); else digitalWrite(P_A3,LOW);
  if (addr & 8) digitalWrite(P_A4,HIGH); else digitalWrite(P_A4,LOW);
  if (addr & 16) digitalWrite(P_A5,HIGH); else digitalWrite(P_A5,LOW);
  if (addr & 32) digitalWrite(P_A6,HIGH); else digitalWrite(P_A6,LOW);
  if (addr & 64) digitalWrite(P_A7,HIGH); else digitalWrite(P_A7,LOW);
  if (addr & 128) digitalWrite(P_A8,HIGH); else digitalWrite(P_A8,LOW);
}

byte readData(){
  byte re = 0;
  if (digitalRead(P_D1) == HIGH) re |= 1;
  if (digitalRead(P_D2) == HIGH) re |= 2;
  if (digitalRead(P_D3) == HIGH) re |= 4;
  if (digitalRead(P_D4) == HIGH) re |= 8;
  return re;
}

void writeData(byte val){
  if (val & 1) digitalWrite(P_W1,HIGH); else digitalWrite(P_W1,LOW);
  if (val & 2) digitalWrite(P_W2,HIGH); else digitalWrite(P_W2,LOW);
  if (val & 4) digitalWrite(P_W3,HIGH); else digitalWrite(P_W3,LOW);
  if (val & 8) digitalWrite(P_W4,HIGH); else digitalWrite(P_W4,LOW);
}

void ReadProm(){
  int x,y;
  byte c;
  Serial.println("");
  Serial.println("");
  
  y = 0;
  for (x=0;x<256;x++){
    setAdresse(x);
    delay(1);       //let time to switch
    c = readData();
    Serial.print(" 0");
    Serial.print(c, HEX);
    y++;
    if (y == 16){
      y=0;
      Serial.println("");
    }
  }

  Serial.println("");
  Serial.print("> ");
  
}

void WriteProm(byte p){
  digitalWrite(P_CS,HIGH);
  writeData(0); //clear it to be safe
  int x,y,r;
  byte c;
  Serial.println("");
  Serial.println("Programmation en cours....");
  
  y = 0;
  for (x=0;x<256;x++){
    setAdresse(x);
    delay(1);       //let time to switch

    if (PromData[p][x] & 1){    //une bit a la fois, on désactive le chip entre chaque bit
      writeData(1);
      digitalWrite(P_CS,LOW);
      delay(1); //let it cook
      digitalWrite(P_CS,HIGH);
      writeData(0);
      delay(1);
    }
    if (PromData[p][x] & 2){
      writeData(2);
      digitalWrite(P_CS,LOW);
      delay(1); //let it cook
      digitalWrite(P_CS,HIGH);
      writeData(0);
      delay(1);
    }
    if (PromData[p][x] & 4){
      writeData(4);
      digitalWrite(P_CS,LOW);
      delay(1); //let it cook
      digitalWrite(P_CS,HIGH);
      writeData(0);
      delay(1);
    }
    if (PromData[p][x] & 8){
      writeData(8);
      digitalWrite(P_CS,LOW);
      delay(1); //let it cook
      digitalWrite(P_CS,HIGH);
      writeData(0);
      delay(1);
    }

    digitalWrite(P_CS,HIGH);
    writeData(0);
  }
  Serial.println("Terminer");
  Serial.println("");
  Serial.print("> ");
  
}

void CompareProm(byte p){
  int x,y,e;
  byte c;
  e = 0;
  Serial.println("");
  Serial.println("");
  
  y = 0;
  for (x=0;x<256;x++){
    setAdresse(x);
    delay(1);       //let time to switch
    c = readData();
    Serial.print(" 0");
    Serial.print(c, HEX);
    if (PromData[p][x] != c) { Serial.print("*"); e = 1;}
    y++;
    if (y == 16){
      y=0;
      Serial.println("");
    }
  }
  if (e==0) Serial.println("Test OK"); else Serial.println("Erreur sur le chip, voire les *");
  Serial.println("");
  Serial.print("> ");
  
}

void loop() {
    if (Serial.available() > 0) {
      byte c = Serial.read();
      Serial.print(char(c));
      if (c == 13){
        //enter
        if (cmdLen == 1){
          if (cmd[0] == 'r') ReadProm();
        }
        if (cmdLen == 2){
          if (cmd[1]-0x31 > 3){
            Serial.println("");
            Serial.println("Erreur - le # du rom doit être entre 1 et 4");
            Serial.println("");
            Serial.print("> ");
          } else {
            if (cmd[0] == 'c') CompareProm(cmd[1]-0x31);
            if (cmd[0] == 'w') WriteProm(cmd[1]-0x31);
          }
        }

        cmdLen = 0;
      }
      else
      {
        cmd[cmdLen] = c;
        cmdLen++;
      }
    }
}

